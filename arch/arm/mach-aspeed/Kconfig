## arch/arm/mach-aspeed/Kconfig
```kconfig
if ARCH_ASPEED


choice
	prompt "Aspeed SoC select"
	optional

config TARGET_AST_G5
       bool "Support Apseed fifth generation SoCs"
       select CPU_ARM1176
       select AST_SPI_NOR

config TARGET_AST_G4
       bool "Support Aspeed fourth generation SoCs"
       select CPU_ARM926EJS
       select AST_SPI_NOR

endchoice

config AST_SPI_NOR
	bool "Enable Aspeed SMC driver"
	help
	  Enable Aspeed SMC driver to access the SPI NOR flash of the
	  BMC

config AST_DISABLE_WDT2
	bool "Disable second Watchdog"
	default false
	help
	  Disable Second Watchdog

config SYS_VENDOR
	default "aspeed"

config SYS_SOC
	default "aspeed"


source "board/aspeed/ast-g5/Kconfig"
source "board/aspeed/ast-g4/Kconfig"

endif
```

## board/aspeed/Kconfig
```kconfig
source "board/aspeed/ast-g5/Kconfig"
source "board/aspeed/ast-g4/Kconfig"

choice
	prompt "Network configuration"
	default ASPEED_NET_NCSI
	help
	  Select Aspeed network configuration

config ASPEED_NET_PHY
	bool "Use a direct attached PHY"

config ASPEED_NET_NCSI
	bool  "Use a network controller attached via NSCI"

endchoice

config AST_SPI_NOR
	bool "Enable Aspeed SMC driver"
	help
	  Enable Aspeed SMC driver to access the SPI NOR flash of the
	  BMC
```

## board/aspeed/ast-g5/Kconfig
```kconfig
if TARGET_AST_G5

config SYS_ARCH
	default "arm"

config SYS_CPU
	default "arm1176"

config SYS_BOARD
	default "ast-g5"

config SYS_CONFIG_NAME
	default "ast-g5"

config DRAM_ECC
	bool "Enable ECC function"
	default n
	help
	  Enable ECC function on Aspeed SoC AST2500

config DRAM_ECC_SIZE
	default 0x10000000

endif
```
